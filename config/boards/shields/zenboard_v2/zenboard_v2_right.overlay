// zenboard_v2_right.overlay


#include "zenboard_v2.dtsi" // Notice that the main dtsi files are included in the overlay.

&default_transform {
    col-offset = <6>;
};

&kscan0 {
    col-gpios
        = <&pro_micro 14 GPIO_ACTIVE_HIGH>
        , <&pro_micro 15 GPIO_ACTIVE_HIGH>
        , <&pro_micro 10 GPIO_ACTIVE_HIGH>
        , <&pro_micro 19 GPIO_ACTIVE_HIGH>
        , <&pro_micro 20 GPIO_ACTIVE_HIGH>
        , <&pro_micro 9 GPIO_ACTIVE_HIGH>
        ;
};
