## config/boards/shields/zenboard_v2/Kconfig.defconfig
```kconfig
if SHIELD_ZENBOARD_V2_RIGHT

config ZMK_KEYBOARD_NAME
    default "zenboard_v2"

config ZMK_SPLIT_ROLE_CENTRAL
    default y

endif

if SHIELD_ZENBOARD_V2_LEFT || SHIELD_ZENBOARD_V2_RIGHT

config ZMK_SPLIT
    default y

endif
```

## config/west.yml
```yaml
manifest:
  remotes:
    - name: incptr
      url-base: https://github.com/incptr
  projects:
    - name: zmk
      remote: incptr
      revision: main
      import: app/west.yml
  self:
    path: config
```
